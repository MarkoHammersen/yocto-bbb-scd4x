## build/conf/bblayers.conf
```bitbake
# POKY_BBLAYERS_CONF_VERSION is increased each time build/conf/bblayers.conf
# changes incompatibly
POKY_BBLAYERS_CONF_VERSION = "2"

BBPATH = "${TOPDIR}"
BBFILES ?= ""

BBLAYERS ?= " \
  /home/me/Documents/yocto-bbb-scd4x/poky/meta \
  /home/me/Documents/yocto-bbb-scd4x/poky/meta-poky \
  /home/me/Documents/yocto-bbb-scd4x/poky/meta-yocto-bsp \
  /home/me/Documents/yocto-bbb-scd4x/meta-custom \
  "
```
